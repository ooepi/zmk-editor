## test/generated/screens_1/config/west.yml
```yaml
manifest:
  remotes:
    - name: zmkfirmware
      url-base: https://github.com/zmkfirmware
    - name: urob
      url-base: https://github.com/urob
    - name: m165437
      url-base: https://github.com/M165437
    - name: infely
      url-base: https://github.com/infely
    - name: dsifry
      url-base: https://github.com/dsifry
    - name: jestar342
      url-base: https://github.com/Jestar342
  projects:
    - name: zmk
      remote: zmkfirmware
      revision: v0.3
      import: app/west.yml
    - name: zmk-helpers
      remote: urob
      revision: v0.3
    - name: zmk-unicode
      remote: urob
      revision: v0.3
    - name: nice-view-gem
      remote: m165437
      revision: v0.3.0
    - name: nice-view-battery
      remote: infely
      revision: a9ebccd6309e21525577dc35fea4eb107bda7cd1
    - name: nice-view-mod
      remote: dsifry
      revision: 5f328cce749b2760cb61dcac30db29432685af69
    - name: nice-shield-spacemarine
      remote: jestar342
      revision: 974a78c6d778e4410a7243b8410d007eb2d23091
  self:
    path: config
```

## test/generated/screens_2/config/west.yml
```yaml
manifest:
  remotes:
    - name: zmkfirmware
      url-base: https://github.com/zmkfirmware
    - name: urob
      url-base: https://github.com/urob
    - name: whoop-t
      url-base: https://github.com/whoop-t
    - name: kevinpastor
      url-base: https://github.com/kevinpastor
    - name: gpeye
      url-base: https://github.com/GPeye
  projects:
    - name: zmk
      remote: zmkfirmware
      revision: v0.3
      import: app/west.yml
    - name: zmk-helpers
      remote: urob
      revision: v0.3
    - name: zmk-unicode
      remote: urob
      revision: v0.3
    - name: nice-adventure-time
      remote: whoop-t
      revision: 42f091646020f615230d1d8d5edca84b6267a9f8
    - name: nice-view-elemental
      remote: kevinpastor
      revision: 69c2ecd56b0b870ddb94b79110ef5a2152ca4a3a
    - name: hammerbeam-slideshow
      remote: gpeye
      revision: 9c16436efa4c87d19e2e4558927969c7ddd5851d
    - name: nice-one-punch-ok
      remote: whoop-t
      revision: 46294fc3646bffaa369db8066b7195f9ebe66520
  self:
    path: config
```

## test/generated/screens_3/config/west.yml
```yaml
manifest:
  remotes:
    - name: zmkfirmware
      url-base: https://github.com/zmkfirmware
    - name: urob
      url-base: https://github.com/urob
    - name: ziembski
      url-base: https://github.com/Ziembski
    - name: gpeye
      url-base: https://github.com/GPeye
    - name: whoop-t
      url-base: https://github.com/whoop-t
  projects:
    - name: zmk
      remote: zmkfirmware
      revision: v0.3
      import: app/west.yml
    - name: zmk-helpers
      remote: urob
      revision: v0.3
    - name: zmk-unicode
      remote: urob
      revision: v0.3
    - name: nice-view-press-start
      remote: ziembski
      revision: 6892f92550d3eecd1d6c8b441f4c441b2e5ec1d4
    - name: urchin-peripheral-animation
      remote: gpeye
      revision: 8b79464acfa8bb4c668e53049ad28b57889f2fe1
    - name: nice-fry-button-miss
      remote: whoop-t
      revision: cd7371d49c2b3f8eaa89b066ceaf8c07bb91cac1
  self:
    path: config
```

## test/generated/screens_4/config/west.yml
```yaml
manifest:
  remotes:
    - name: zmkfirmware
      url-base: https://github.com/zmkfirmware
    - name: urob
      url-base: https://github.com/urob
    - name: whoop-t
      url-base: https://github.com/whoop-t
    - name: gpeye
      url-base: https://github.com/GPeye
  projects:
    - name: zmk
      remote: zmkfirmware
      revision: v0.3
      import: app/west.yml
    - name: zmk-helpers
      remote: urob
      revision: v0.3
    - name: zmk-unicode
      remote: urob
      revision: v0.3
    - name: nice-futurama-sus
      remote: whoop-t
      revision: a7483284912a8af90fdc02e4ea67317703684a5a
    - name: mario-peripheral-animation
      remote: gpeye
      revision: 1aa3950d6c86b4240b3f79d06bdbb04c5d920711
    - name: nice-luffy-wanted
      remote: whoop-t
      revision: 5bff523975f87f01812d9df1045bc34a90dfd756
  self:
    path: config
```

## test/generated/screens_5/config/west.yml
```yaml
manifest:
  remotes:
    - name: zmkfirmware
      url-base: https://github.com/zmkfirmware
    - name: urob
      url-base: https://github.com/urob
    - name: mctechnology17
      url-base: https://github.com/mctechnology17
    - name: whoop-t
      url-base: https://github.com/whoop-t
  projects:
    - name: zmk
      remote: zmkfirmware
      revision: v0.3
      import: app/west.yml
    - name: zmk-helpers
      remote: urob
      revision: v0.3
    - name: zmk-unicode
      remote: urob
      revision: v0.3
    - name: zmk-nice-oled
      remote: mctechnology17
      revision: v0.0.2
    - name: nice-luffy-gear-five
      remote: whoop-t
      revision: 1d203a9b60d2b537f308186fe8dc247df6633b23
  self:
    path: config
```
